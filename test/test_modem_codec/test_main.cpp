// Payload layouts, cross-checked against the meshkit Python implementation.
//
// The VEC_* vectors below were produced by the Python codec. Decoding them here
// and getting the expected fields back is what proves the two implementations
// agree on the wire, rather than merely agreeing with themselves.

#include "TestUtil.h"
#include <Arduino.h>
#include <unity.h>

#include "modem/ModemCodec.h"
#include <cstdio>
#include <cstring>

// Generated by the Python codec - see meshkit/python.
static const uint8_t VEC_POSITION[] = {0x68, 0x31, 0x64, 0x16, 0x20, 0x4E, 0xAF, 0x4B, 0x26, 0x00,
                                       0x00, 0x00, 0x00, 0x00, 0x00, 0x00, 0x00, 0xF1, 0x53, 0x65,
                                       0x00, 0x00, 0x00, 0x00, 0x00, 0x00, 0x00, 0x00, 0x00, 0x00,
                                       0x00, 0x00, 0x00, 0x00, 0x00, 0x03, 0x09, 0x00, 0x00, 0x00};
static const uint8_t VEC_POSITION_SOUTH[] = {0x00, 0x08, 0xD0, 0xEB, 0xB8, 0x4A, 0xDF, 0xA5, 0x00, 0x00,
                                       0x00, 0x00, 0x00, 0x00, 0x00, 0x00, 0x00, 0x00, 0x00, 0x00,
                                       0x00, 0x00, 0x00, 0x00, 0x00, 0x00, 0x00, 0x00, 0x00, 0x00,
                                       0x00, 0x00, 0x00, 0x00, 0x00, 0x00, 0x00, 0x00, 0x00, 0x00};
static const uint8_t VEC_POSITION_TRACKER[] = {0xD4, 0x0A, 0xAC, 0x15, 0xEC, 0x55, 0xEF, 0x4B, 0x32, 0x00,
                                       0x00, 0x00, 0x48, 0x00, 0x00, 0x00, 0xF6, 0xE5, 0x6E, 0x6A,
                                       0xA8, 0x61, 0x00, 0x00, 0x40, 0x54, 0x89, 0x00, 0x50, 0x00,
                                       0x78, 0x00, 0xB8, 0x0B, 0x20, 0x03, 0x0B, 0x03, 0x04, 0x00};
static const uint8_t VEC_REGION[] = {0x0C, 0x00, 0x00, 0x14, 0x90, 0xD0, 0x03, 0x00,
                                     0x0B, 0x05, 0x01, 0x00, 0xC0, 0xDC, 0x03, 0x37};
static const uint8_t VEC_TXPARAMS[] = {0xFB, 0x03, 0x00, 0x00};
static const uint8_t VEC_IDENTITY[] = {0x06, 0x01, 0x0C, 0x03, 0x50, 0x75, 0x6D, 0x70, 0x20, 0x48,
                                       0x6F, 0x75, 0x73, 0x65, 0x20, 0x33, 0x50, 0x48, 0x33};
static const uint8_t VEC_IDENTITY_REPLY[] = {0x00, 0x02, 0x01, 0x48, 0x43, 0x20, 0x0F, 0x50, 0x0D, 0x04,
                                             0x00, 0x00, 0x52, 0x41, 0x4B, 0x33, 0x31, 0x37, 0x32, 0x20,
                                             0x4D, 0x6F, 0x64, 0x65, 0x6D, 0x52, 0x4B, 0x37, 0x32};

static const uint8_t VEC_NODE_INFO[] = {0x00, 0x01, 0x02, 0x1B, 0x4C, 0xA0, 0xDC, 0x2E, 0xF6, 0xE5, 0x6E, 0x6A, 0xD4,
                                        0x0A, 0xAC, 0x15, 0xEC, 0x55, 0xEF, 0x4B, 0x32, 0x00, 0x00, 0x00, 0xDC, 0xE5,
                                        0x6E, 0x6A, 0x1A, 0x5E, 0x93, 0x0F, 0x0C, 0x04, 0x00, 0x00, 0x23, 0x49, 0x6F,
                                        0x54, 0x4D, 0x61, 0x64, 0x65, 0x45, 0x61, 0x73, 0x79, 0x61, 0x30, 0x34, 0x63};

static const uint8_t VEC_CHANNEL[] = {0x01, 0x02, 0x10, 0x06, 0x00, 0x01, 0x02, 0x03, 0x04, 0x05, 0x06, 0x07, 0x08,
                                      0x09, 0x0A, 0x0B, 0x0C, 0x0D, 0x0E, 0x0F, 0x73, 0x69, 0x74, 0x65, 0x2D, 0x61};
static const uint8_t VEC_RXPOLICY[] = {0x01, 0x01, 0x03, 0x02, 0xE9, 0x00, 0x14, 0x00, 0x00, 0x02, 0x00, 0x00,
                                       0x01, 0x43, 0x4F, 0xEF, 0xBE, 0xAD, 0xDE, 0xEE, 0xFF, 0xC0, 0x00};
static const uint8_t VEC_TELEMETRY[] = {0x02, 0x02, 0x01, 0xFE, 0x2E, 0x09, 0x00, 0x00,
                                        0x02, 0x00, 0xD8, 0xFF, 0xFF, 0xFF, 0x00};
static const uint8_t VEC_SENDBINARY[] = {0x34, 0x12, 0x00, 0x00, 0x2C, 0x01, 0x05, 0x03,
                                         0x00, 0x00, 0x03, 0x00, 0x01, 0x02, 0x03};
static const uint8_t VEC_SENDTEXT[] = {0x99, 0x00, 0x00, 0x00, 0x01, 0x00, 0x0D, 0x00, 0xEC, 0x84, 0xA4,
                                       0xEB, 0xB9, 0x84, 0x20, 0xEC, 0xA0, 0x95, 0xEC, 0x83, 0x81};
static const uint8_t VEC_SECURITY[] = {0x20, 0x00, 0x00, 0x00, 0x00, 0x01, 0x02, 0x03, 0x04, 0x05, 0x06, 0x07,
                                       0x08, 0x09, 0x0A, 0x0B, 0x0C, 0x0D, 0x0E, 0x0F, 0x10, 0x11, 0x12, 0x13,
                                       0x14, 0x15, 0x16, 0x17, 0x18, 0x19, 0x1A, 0x1B, 0x1C, 0x1D, 0x1E, 0x1F};
static const uint8_t VEC_BOOTLOADER[] = {0x10, 0x07, 0xB0, 0x1E};

// ---------------------------------------------------------------------------
// Group C1 - decode the Python vectors

static void test_C1a_position()
{
    ModemPosition p;
    TEST_ASSERT_TRUE(modemDecodePosition(VEC_POSITION, sizeof(VEC_POSITION), &p));
    TEST_ASSERT_EQUAL_INT32(375665000, p.latitude_i);
    TEST_ASSERT_EQUAL_INT32(1269780000, p.longitude_i);
    TEST_ASSERT_EQUAL_INT32(38, p.altitude_m);
    TEST_ASSERT_EQUAL_UINT32(1700000000u, p.timestamp_unix);
    TEST_ASSERT_EQUAL_UINT8(3, p.fix_type);
    TEST_ASSERT_EQUAL_UINT8(9, p.sats_in_view);
}

static void test_C1b_position_negative_coordinates()
{
    ModemPosition p;
    TEST_ASSERT_TRUE(modemDecodePosition(VEC_POSITION_SOUTH, sizeof(VEC_POSITION_SOUTH), &p));
    TEST_ASSERT_EQUAL_INT32(-338688000, p.latitude_i);
    TEST_ASSERT_EQUAL_INT32(-1512093000, p.longitude_i);
}

static void test_C1c_region_profile()
{
    ModemRegionProfile r;
    TEST_ASSERT_TRUE(modemDecodeRegionProfile(VEC_REGION, sizeof(VEC_REGION), &r));
    TEST_ASSERT_EQUAL_UINT8(12, r.region);
    TEST_ASSERT_FALSE(r.use_preset);
    TEST_ASSERT_EQUAL_UINT32(250000u, r.bandwidth_hz);
    TEST_ASSERT_EQUAL_UINT8(11, r.spread_factor);
    TEST_ASSERT_EQUAL_UINT8(5, r.coding_rate);
    TEST_ASSERT_EQUAL_UINT8(20, r.channel_num);
    TEST_ASSERT_TRUE(r.override_duty_cycle);
    TEST_ASSERT_EQUAL_UINT32(923000000u, r.override_freq_hz);
}

static void test_C1d_tx_params_negative_power()
{
    ModemTxParams t;
    TEST_ASSERT_TRUE(modemDecodeTxParams(VEC_TXPARAMS, sizeof(VEC_TXPARAMS), &t));
    TEST_ASSERT_EQUAL_INT8(-5, t.tx_power_dbm);
    TEST_ASSERT_EQUAL_UINT8(3, t.hop_limit);
    TEST_ASSERT_FALSE(t.tx_enabled);
}

static void test_C1e_identity()
{
    ModemIdentity id;
    TEST_ASSERT_TRUE(modemDecodeIdentity(VEC_IDENTITY, sizeof(VEC_IDENTITY), &id));
    TEST_ASSERT_EQUAL_UINT8(6, id.role);
    TEST_ASSERT_TRUE(id.is_unmessagable);
    TEST_ASSERT_EQUAL_UINT8(12, id.long_name_len);
    TEST_ASSERT_EQUAL_UINT8(3, id.short_name_len);
    TEST_ASSERT_EQUAL_MEMORY("Pump House 3", id.long_name, 12);
    TEST_ASSERT_EQUAL_MEMORY("PH3", id.short_name, 3);
}

static void test_C1f_channel()
{
    ModemChannel c;
    TEST_ASSERT_TRUE(modemDecodeChannel(VEC_CHANNEL, sizeof(VEC_CHANNEL), &c));
    TEST_ASSERT_EQUAL_UINT8(1, c.index);
    TEST_ASSERT_EQUAL_UINT8(2, c.role);
    TEST_ASSERT_EQUAL_UINT8(16, c.psk_len);
    TEST_ASSERT_EQUAL_UINT8(6, c.name_len);
    TEST_ASSERT_EQUAL_MEMORY("site-a", c.name, 6);
    for (uint8_t i = 0; i < 16; i++)
        TEST_ASSERT_EQUAL_UINT8(i, c.psk[i]);
}

static void test_C1g_rx_policy()
{
    ModemRxPolicy p;
    TEST_ASSERT_TRUE(modemDecodeRxPolicy(VEC_RXPOLICY, sizeof(VEC_RXPOLICY), &p));
    TEST_ASSERT_EQUAL_UINT8(MODEM_TEXT_RX_ALLOWLIST, p.text_rx_mode);
    TEST_ASSERT_EQUAL_UINT8(MODEM_PORTNUM_ALLOWLIST, p.portnum_mode);
    TEST_ASSERT_EQUAL_UINT16(233, p.max_payload_len);
    TEST_ASSERT_EQUAL_UINT16(20, p.uart_budget_pps);
    TEST_ASSERT_EQUAL_UINT16(512, p.per_sender_pps_q8);
    TEST_ASSERT_EQUAL_UINT8(3, p.portnum_count);
    TEST_ASSERT_EQUAL_UINT8(1, p.portnums[0]);
    TEST_ASSERT_EQUAL_UINT8(67, p.portnums[1]);
    TEST_ASSERT_EQUAL_UINT8(79, p.portnums[2]);

    uint32_t sender = 0;
    TEST_ASSERT_TRUE(modemRxPolicySender(&p, 0, &sender));
    TEST_ASSERT_EQUAL_HEX32(0xDEADBEEFu, sender);
    TEST_ASSERT_TRUE(modemRxPolicySender(&p, 1, &sender));
    TEST_ASSERT_EQUAL_HEX32(0x00C0FFEEu, sender);
    TEST_ASSERT_FALSE(modemRxPolicySender(&p, 2, &sender));
}

static void test_C1h_telemetry()
{
    ModemTelemetry t;
    TEST_ASSERT_TRUE(modemDecodeTelemetry(VEC_TELEMETRY, sizeof(VEC_TELEMETRY), &t));
    TEST_ASSERT_EQUAL_UINT8(2, t.variant);
    TEST_ASSERT_EQUAL_UINT8(2, t.metric_count);

    ModemMetric m;
    TEST_ASSERT_TRUE(modemTelemetryMetric(&t, 0, &m));
    TEST_ASSERT_EQUAL_UINT8(1, m.metric_id);
    TEST_ASSERT_EQUAL_INT8(-2, m.scale10);
    TEST_ASSERT_EQUAL_INT32(2350, m.value);

    TEST_ASSERT_TRUE(modemTelemetryMetric(&t, 1, &m));
    TEST_ASSERT_EQUAL_INT32(-40, m.value);
    TEST_ASSERT_FALSE(modemTelemetryMetric(&t, 2, &m));
    TEST_ASSERT_EQUAL_UINT8(0, t.text_len);
}

static void test_C1i_send_binary()
{
    ModemSendBinary s;
    TEST_ASSERT_TRUE(modemDecodeSendBinary(VEC_SENDBINARY, sizeof(VEC_SENDBINARY), &s));
    TEST_ASSERT_EQUAL_HEX32(0x1234u, s.dest_node);
    TEST_ASSERT_EQUAL_UINT16(300, s.portnum); // beyond a byte, in the private range
    TEST_ASSERT_EQUAL_UINT8(0x05, s.flags);   // want_ack | pki
    TEST_ASSERT_EQUAL_UINT8(3, s.hop_limit);
    TEST_ASSERT_EQUAL_UINT16(3, s.payload_len);
    TEST_ASSERT_EQUAL_MEMORY("\x01\x02\x03", s.payload, 3);
}

static void test_C1j_send_text_utf8()
{
    ModemSendText s;
    TEST_ASSERT_TRUE(modemDecodeSendText(VEC_SENDTEXT, sizeof(VEC_SENDTEXT), &s));
    TEST_ASSERT_EQUAL_HEX32(0x99u, s.dest_node);
    TEST_ASSERT_EQUAL_UINT8(1, s.channel_index);
    TEST_ASSERT_EQUAL_UINT16(13, s.text_len); // 4 Hangul syllables plus a space
}

static void test_C1k_security()
{
    ModemSecurity s;
    TEST_ASSERT_TRUE(modemDecodeSecurity(VEC_SECURITY, sizeof(VEC_SECURITY), &s));
    TEST_ASSERT_EQUAL_UINT8(32, s.key_len);
    TEST_ASSERT_FALSE(s.generate);
    for (uint8_t i = 0; i < 32; i++)
        TEST_ASSERT_EQUAL_UINT8(i, s.private_key[i]);
}

static void test_C1l_bootloader_magic()
{
    TEST_ASSERT_TRUE(modemDecodeEnterBootloader(VEC_BOOTLOADER, sizeof(VEC_BOOTLOADER)));

    const uint8_t wrong[] = {0x00, 0x00, 0x00, 0x00};
    TEST_ASSERT_FALSE(modemDecodeEnterBootloader(wrong, sizeof(wrong)));
}

// ---------------------------------------------------------------------------
// Group C2 - encoders produce the sizes the specification fixes

static void test_C2a_encoded_sizes()
{
    uint8_t buf[64];
    const uint8_t fw[3] = {2, 7, 27};

    TEST_ASSERT_EQUAL_UINT16(17, modemEncodeHelloReply(buf, sizeof(buf), MODEM_OK, 1, 7, 0xABCD, 0x1234, fw, 0));

    ModemConfigDigest digest = {};
    TEST_ASSERT_EQUAL_UINT16(16, modemEncodeConfigDigest(buf, sizeof(buf), MODEM_OK, &digest));

    ModemMeshStatus mesh = {};
    TEST_ASSERT_EQUAL_UINT16(32, modemEncodeMeshStatus(buf, sizeof(buf), MODEM_OK, &mesh));

    TEST_ASSERT_EQUAL_UINT16(8, modemEncodeSendReply(buf, sizeof(buf), MODEM_OK, 0xCAFE));

    ModemHealth health = {};
    TEST_ASSERT_EQUAL_UINT16(20, modemEncodeHealth(buf, sizeof(buf), &health));

    ModemTxStatus tx = {};
    TEST_ASSERT_EQUAL_UINT16(8, modemEncodeTxStatus(buf, sizeof(buf), &tx));

    ModemMeshState state = {};
    TEST_ASSERT_EQUAL_UINT16(8, modemEncodeMeshState(buf, sizeof(buf), &state));

    ModemRebooted rebooted = {};
    TEST_ASSERT_EQUAL_UINT16(8, modemEncodeRebooted(buf, sizeof(buf), &rebooted));

    ModemNodeEntry entry = {};
    TEST_ASSERT_EQUAL_UINT16(16, modemEncodeNodeEntry(buf, sizeof(buf), &entry));
    TEST_ASSERT_EQUAL_UINT8(0, buf[12]); // no signal strength field here - see the specification
}

static void test_C2b_send_reply_zeroes_tx_id_on_error()
{
    uint8_t buf[8];
    modemEncodeSendReply(buf, sizeof(buf), MODEM_ERR_TX_QUEUE_FULL, 0xCAFE);

    TEST_ASSERT_EQUAL_UINT8(MODEM_ERR_TX_QUEUE_FULL, buf[0]);
    for (int i = 4; i < 8; i++)
        TEST_ASSERT_EQUAL_UINT8(0, buf[i]);
}

static void test_C2c_health_field_placement()
{
    uint8_t buf[20];
    ModemHealth health = {};
    health.session_epoch = 9;
    health.uptime_s = 3600;
    health.node_count = 42;
    health.channel_util_pct = 30;
    health.air_util_tx_pct = 11;
    health.state = MODEM_STATE_UNDER_ATTACK;

    TEST_ASSERT_EQUAL_UINT16(20, modemEncodeHealth(buf, sizeof(buf), &health));
    TEST_ASSERT_EQUAL_UINT8(9, buf[0]);
    TEST_ASSERT_EQUAL_UINT8(42, buf[8]);
    TEST_ASSERT_EQUAL_UINT8(30, buf[14]);
    TEST_ASSERT_EQUAL_UINT8(11, buf[15]);
    TEST_ASSERT_EQUAL_UINT8(MODEM_STATE_UNDER_ATTACK, buf[16]);
    TEST_ASSERT_EQUAL_UINT8(0, buf[17]);
}

static void test_C2d_rx_headers_and_negative_rssi()
{
    uint8_t buf[64];

    ModemRxDataHeader data = {};
    data.from_node = 0x55;
    data.portnum = 67;
    data.rssi_dbm = -102;
    data.snr_q2 = -6;
    TEST_ASSERT_EQUAL_UINT16(18 + 3, modemEncodeRxData(buf, sizeof(buf), &data, (const uint8_t *)"abc", 3));
    TEST_ASSERT_EQUAL_UINT8(0x9A, buf[8]); // -102 as little-endian i16
    TEST_ASSERT_EQUAL_UINT8(0xFF, buf[9]);
    TEST_ASSERT_EQUAL_UINT8(0xFA, buf[10]); // -6 as i8
    TEST_ASSERT_EQUAL_MEMORY("abc", &buf[18], 3);

    ModemRxTextHeader text = {};
    text.from_node = 0x77;
    TEST_ASSERT_EQUAL_UINT16(17 + 2, modemEncodeRxText(buf, sizeof(buf), &text, (const uint8_t *)"ok", 2));
    TEST_ASSERT_EQUAL_MEMORY("ok", &buf[17], 2);
}

static void test_C2e_encoders_refuse_a_short_buffer()
{
    uint8_t buf[4];
    ModemHealth health = {};
    TEST_ASSERT_EQUAL_UINT16(0, modemEncodeHealth(buf, sizeof(buf), &health));

    ModemRxDataHeader data = {};
    TEST_ASSERT_EQUAL_UINT16(0, modemEncodeRxData(buf, sizeof(buf), &data, (const uint8_t *)"abc", 3));
}

static void test_C2f_rx_data_refuses_to_exceed_max_payload()
{
    static uint8_t buf[MODEM_MAX_PAYLOAD * 2];
    static uint8_t body[MODEM_MAX_PAYLOAD];
    ModemRxDataHeader data = {};

    TEST_ASSERT_EQUAL_UINT16(0, modemEncodeRxData(buf, sizeof(buf), &data, body, MODEM_MAX_PAYLOAD));
}

// ---------------------------------------------------------------------------
// Group C3 - malformed input

static void test_C3a_fixed_layouts_reject_wrong_length()
{
    const uint8_t one[1] = {0};
    ModemPosition p;
    ModemRegionProfile r;
    ModemTxParams t;
    ModemHello h;

    TEST_ASSERT_FALSE(modemDecodePosition(one, 1, &p));
    TEST_ASSERT_FALSE(modemDecodeRegionProfile(one, 1, &r));
    TEST_ASSERT_FALSE(modemDecodeTxParams(one, 1, &t));
    TEST_ASSERT_FALSE(modemDecodeHello(one, 1, &h));

    // A longer-than-specified payload is refused too: silent truncation hides bugs.
    uint8_t padded[MODEM_POSITION_SIZE + 1] = {};
    TEST_ASSERT_FALSE(modemDecodePosition(padded, sizeof(padded), &p));
}

static void test_C3b_declared_length_beyond_the_buffer_is_rejected()
{
    uint8_t frame[12] = {};
    frame[10] = 0xFF; // payload_len = 255 with nothing after it
    frame[11] = 0x00;

    ModemSendBinary s;
    TEST_ASSERT_FALSE(modemDecodeSendBinary(frame, sizeof(frame), &s));

    uint8_t text[8] = {};
    text[6] = 0xFF;
    ModemSendText t;
    TEST_ASSERT_FALSE(modemDecodeSendText(text, sizeof(text), &t));
}

static void test_C3c_channel_rejects_an_invalid_psk_length()
{
    uint8_t buf[32] = {};
    buf[2] = 8; // not one of 0, 1, 16, 32
    ModemChannel c;
    TEST_ASSERT_FALSE(modemDecodeChannel(buf, sizeof(buf), &c));
}

static void test_C3d_security_rejects_an_invalid_key_length()
{
    uint8_t buf[32] = {};
    buf[0] = 16;
    ModemSecurity s;
    TEST_ASSERT_FALSE(modemDecodeSecurity(buf, sizeof(buf), &s));
}

static void test_C3e_decoders_never_read_past_the_buffer()
{
    uint32_t state = 0xC0DEC0DEu;
    uint8_t scratch[64];

    for (unsigned iter = 0; iter < 20000; iter++) {
        state = state * 1103515245u + 12345u;
        const uint16_t len = (uint16_t)((state >> 16) % (sizeof(scratch) + 1));
        for (uint16_t i = 0; i < len; i++) {
            state = state * 1103515245u + 12345u;
            scratch[i] = (uint8_t)(state >> 16);
        }

        ModemIdentity id;
        ModemChannel ch;
        ModemSecurity se;
        ModemRxPolicy rp;
        ModemTelemetry te;
        ModemSendBinary sb;
        ModemSendText st;

        // Any of these may fail; none may read out of bounds. The sanitizers in
        // the coverage environment turn a violation into a failure.
        if (modemDecodeIdentity(scratch, len, &id))
            TEST_ASSERT_TRUE(4u + id.long_name_len + id.short_name_len <= len);
        if (modemDecodeChannel(scratch, len, &ch))
            TEST_ASSERT_TRUE(4u + ch.psk_len + ch.name_len <= len);
        if (modemDecodeSecurity(scratch, len, &se))
            TEST_ASSERT_TRUE(4u + se.key_len <= len);
        if (modemDecodeRxPolicy(scratch, len, &rp))
            TEST_ASSERT_TRUE(12u + rp.portnum_count + (uint32_t)rp.sender_count * 4u <= len);
        if (modemDecodeTelemetry(scratch, len, &te))
            TEST_ASSERT_TRUE(2u + (uint32_t)te.metric_count * 6u <= len);
        if (modemDecodeSendBinary(scratch, len, &sb))
            TEST_ASSERT_TRUE(10u + sb.payload_len <= len);
        if (modemDecodeSendText(scratch, len, &st))
            TEST_ASSERT_TRUE(8u + st.text_len <= len);
    }
}

// ---------------------------------------------------------------------------
void setUp(void) {}
void tearDown(void) {}


static void test_C4a_identity_reply_matches_the_host_vector()
{
    ModemIdentityInfo info = {};
    info.node_num = 0x500F2043u;
    info.role = 2;
    info.is_unmessagable = true;
    info.hw_model = 72;

    uint8_t buf[64] = {};
    const uint16_t len = modemEncodeIdentityReply(buf, sizeof(buf), MODEM_OK, &info, "RAK3172 Modem", "RK72");
    TEST_ASSERT_EQUAL_UINT16(sizeof(VEC_IDENTITY_REPLY), len);
    TEST_ASSERT_EQUAL_UINT8_ARRAY(VEC_IDENTITY_REPLY, buf, len);
}

static void test_C4b_node_info_matches_the_host_vector()
{
    ModemNodeInfo info = {};
    info.node_num = 0x2EDCA04Cu;
    info.last_heard = 1785652726u;
    info.latitude_i = 363596500;
    info.longitude_i = 1273976300;
    info.altitude_m = 50;
    info.position_time = 1785652700u;
    info.voltage_mv = 3987;
    info.snr_q2 = 26;
    info.hops_away = 2;
    info.role = 1;
    info.flags = 0x1B;
    info.battery_level = 94;

    uint8_t buf[96] = {};
    const uint16_t len = modemEncodeNodeInfo(buf, sizeof(buf), MODEM_OK, &info, "#IoTMadeEasy", "a04c");
    TEST_ASSERT_EQUAL_UINT16(sizeof(VEC_NODE_INFO), len);
    TEST_ASSERT_EQUAL_UINT8_ARRAY(VEC_NODE_INFO, buf, len);
}

static void test_C4c_name_encoders_refuse_a_buffer_that_cannot_hold_the_names()
{
    ModemIdentityInfo info = {};
    uint8_t buf[MODEM_IDENTITY_REPLY_HEAD_SIZE + 3] = {};

    TEST_ASSERT_EQUAL_UINT16(0, modemEncodeIdentityReply(buf, sizeof(buf), MODEM_OK, &info, "abcd", ""));
    TEST_ASSERT_EQUAL_UINT16(MODEM_IDENTITY_REPLY_HEAD_SIZE + 3,
                             modemEncodeIdentityReply(buf, sizeof(buf), MODEM_OK, &info, "abc", ""));
    TEST_ASSERT_EQUAL_UINT16(0, modemEncodeIdentityReply(buf, MODEM_IDENTITY_REPLY_HEAD_SIZE - 1, MODEM_OK, &info,
                                                         "", ""));
}

static void test_C4d_node_info_request_takes_exactly_four_bytes()
{
    const uint8_t good[4] = {0x4C, 0xA0, 0xDC, 0x2E};
    uint32_t num = 0;

    TEST_ASSERT_TRUE(modemDecodeNodeInfoRequest(good, sizeof(good), &num));
    TEST_ASSERT_EQUAL_UINT32(0x2EDCA04Cu, num);
    TEST_ASSERT_FALSE(modemDecodeNodeInfoRequest(good, 3, &num));
    TEST_ASSERT_FALSE(modemDecodeNodeInfoRequest(good, 5, &num));
}


static void test_C5a_telemetry_carries_a_trailing_string()
{
    const uint8_t vec[] = {0x06, 0x01, 0x01, 0x00, 0x10, 0x0E, 0x00, 0x00, 0x04, 'p', 'u', 'm', 'p'};

    ModemTelemetry t;
    TEST_ASSERT_TRUE(modemDecodeTelemetry(vec, sizeof(vec), &t));
    TEST_ASSERT_EQUAL_UINT8(6, t.variant);
    TEST_ASSERT_EQUAL_UINT8(1, t.metric_count);
    TEST_ASSERT_EQUAL_UINT8(4, t.text_len);
    TEST_ASSERT_EQUAL_MEMORY("pump", t.utf8, 4);
}

static void test_C5b_telemetry_rejects_a_string_past_the_buffer()
{
    uint8_t vec[9] = {0x06, 0x01, 0x01, 0x00, 0x10, 0x0E, 0x00, 0x00, 0x7F};

    ModemTelemetry t;
    TEST_ASSERT_FALSE(modemDecodeTelemetry(vec, sizeof(vec), &t));

    vec[8] = 0x00;
    TEST_ASSERT_TRUE(modemDecodeTelemetry(vec, sizeof(vec), &t));
}

static void test_C5c_utf8_accepts_well_formed_sequences()
{
    const uint8_t ascii[] = {'o', 'k'};
    const uint8_t hangul[] = {0xEC, 0x84, 0xA4, 0xEB, 0xB9, 0x84};
    const uint8_t emoji[] = {0xF0, 0x9F, 0x94, 0x8B};

    TEST_ASSERT_TRUE(modemIsValidUtf8(ascii, sizeof(ascii)));
    TEST_ASSERT_TRUE(modemIsValidUtf8(hangul, sizeof(hangul)));
    TEST_ASSERT_TRUE(modemIsValidUtf8(emoji, sizeof(emoji)));
    TEST_ASSERT_TRUE(modemIsValidUtf8(ascii, 0));
}

static void test_C5d_utf8_rejects_the_classic_malformations()
{
    const uint8_t truncated[] = {0xEC, 0x84};
    const uint8_t overlong[] = {0xC0, 0xAF};
    const uint8_t surrogate[] = {0xED, 0xA0, 0x80};
    const uint8_t too_high[] = {0xF5, 0x80, 0x80, 0x80};
    const uint8_t lone_continuation[] = {0x80};
    const uint8_t bad_continuation[] = {0xEC, 0x84, 0x41};

    TEST_ASSERT_FALSE(modemIsValidUtf8(truncated, sizeof(truncated)));
    TEST_ASSERT_FALSE(modemIsValidUtf8(overlong, sizeof(overlong)));
    TEST_ASSERT_FALSE(modemIsValidUtf8(surrogate, sizeof(surrogate)));
    TEST_ASSERT_FALSE(modemIsValidUtf8(too_high, sizeof(too_high)));
    TEST_ASSERT_FALSE(modemIsValidUtf8(lone_continuation, sizeof(lone_continuation)));
    TEST_ASSERT_FALSE(modemIsValidUtf8(bad_continuation, sizeof(bad_continuation)));
}


static void test_C6a_type_space_puts_every_response_in_its_own_quarter()
{
    for (unsigned t = 0x01; t <= 0x3F; t++) {
        TEST_ASSERT_TRUE(modemTypeIsCommand((uint8_t)t));
        TEST_ASSERT_TRUE(modemTypeIsCommandResponse(modemResponseFor((uint8_t)t)));
        TEST_ASSERT_EQUAL_UINT8(t, modemRequestFor(modemResponseFor((uint8_t)t)));
    }

    for (unsigned t = 0x40; t <= 0x7F; t++) {
        TEST_ASSERT_TRUE(modemTypeIsEvent((uint8_t)t));
        TEST_ASSERT_TRUE(modemTypeIsHostResponse(modemResponseFor((uint8_t)t)));
        TEST_ASSERT_EQUAL_UINT8(t, modemRequestFor(modemResponseFor((uint8_t)t)));
    }
}

static void test_C6b_the_four_kinds_never_overlap()
{
    for (unsigned t = 0; t <= 0xFF; t++) {
        const uint8_t type = (uint8_t)t;
        const unsigned kinds = (modemTypeIsCommand(type) ? 1u : 0u) + (modemTypeIsEvent(type) ? 1u : 0u) +
                               (modemTypeIsCommandResponse(type) ? 1u : 0u) + (modemTypeIsHostResponse(type) ? 1u : 0u);
        TEST_ASSERT_EQUAL_UINT32(type == 0x00 ? 0u : 1u, kinds);
    }
}

static void test_C6c_every_defined_command_stays_inside_its_range()
{
    const uint8_t commands[] = {MODEM_CMD_HELLO,         MODEM_CMD_GET_MODEM_STATUS, MODEM_CMD_SET_IDENTITY,
                                MODEM_CMD_SET_RX_POLICY, MODEM_CMD_GET_IDENTITY,     MODEM_CMD_GET_CONFIG_DIGEST,
                                MODEM_CMD_SET_POSITION,  MODEM_CMD_ANNOUNCE,         MODEM_CMD_GET_NODE_INFO,
                                MODEM_CMD_ENTER_BOOTLOADER};

    for (size_t i = 0; i < sizeof(commands) / sizeof(commands[0]); i++) {
        TEST_ASSERT_TRUE(modemTypeIsCommand(commands[i]));
        TEST_ASSERT_TRUE(modemTypeIsCommandResponse(modemResponseFor(commands[i])));
    }

    const uint8_t modemSide[] = {MODEM_EVT_REBOOTED, MODEM_EVT_HEALTH,    MODEM_EVT_RX_DATA,
                                 MODEM_EVT_RX_TEXT,  MODEM_EVT_TX_STATUS, MODEM_EVT_MESH_STATE,
                                 MODEM_QRY_TELEMETRY};

    for (size_t i = 0; i < sizeof(modemSide) / sizeof(modemSide[0]); i++)
        TEST_ASSERT_TRUE(modemTypeIsEvent(modemSide[i]));
}

static void test_C6d_query_telemetry_is_eight_bytes()
{
    uint8_t buf[MODEM_QUERY_TELEMETRY_SIZE] = {};
    TEST_ASSERT_EQUAL_UINT16(8, modemEncodeQueryTelemetry(buf, sizeof(buf), 0x2EDCA04Cu, 2));
    TEST_ASSERT_EQUAL_HEX8(0x4C, buf[0]);
    TEST_ASSERT_EQUAL_HEX8(0x2E, buf[3]);
    TEST_ASSERT_EQUAL_UINT8(2, buf[4]);
    TEST_ASSERT_EQUAL_UINT16(0, modemEncodeQueryTelemetry(buf, 7, 0, 0));
}


static void test_C7a_position_carries_a_tracker_fix()
{
    ModemPosition p;
    TEST_ASSERT_TRUE(modemDecodePosition(VEC_POSITION_TRACKER, sizeof(VEC_POSITION_TRACKER), &p));
    TEST_ASSERT_EQUAL_INT32(363596500, p.latitude_i);
    TEST_ASSERT_EQUAL_INT32(72, p.altitude_hae);
    TEST_ASSERT_EQUAL_UINT32(25000u, p.ground_speed_mmps);
    TEST_ASSERT_EQUAL_UINT32(9000000u, p.ground_track);
    TEST_ASSERT_EQUAL_UINT16(80, p.hdop);
    TEST_ASSERT_EQUAL_UINT16(120, p.pdop);
    TEST_ASSERT_EQUAL_UINT16(3000, p.gps_accuracy_mm);
    TEST_ASSERT_EQUAL_UINT8(11, p.sats_in_view);
    TEST_ASSERT_EQUAL_UINT8(3, p.loc_source);
    TEST_ASSERT_EQUAL_UINT8(4, p.alt_source);
}

static void test_C7b_position_round_trips_through_the_encoder()
{
    ModemPosition p;
    TEST_ASSERT_TRUE(modemDecodePosition(VEC_POSITION_TRACKER, sizeof(VEC_POSITION_TRACKER), &p));

    uint8_t out[MODEM_POSITION_SIZE] = {};
    TEST_ASSERT_EQUAL_UINT16(MODEM_POSITION_SIZE, modemEncodePosition(out, sizeof(out), &p));
    TEST_ASSERT_EQUAL_UINT8_ARRAY(VEC_POSITION_TRACKER, out, MODEM_POSITION_SIZE);
    TEST_ASSERT_EQUAL_UINT16(0, modemEncodePosition(out, MODEM_POSITION_SIZE - 1, &p));
}

static void test_C7c_unset_provenance_survives_untouched()
{
    ModemPosition p;
    TEST_ASSERT_TRUE(modemDecodePosition(VEC_POSITION_SOUTH, sizeof(VEC_POSITION_SOUTH), &p));
    TEST_ASSERT_EQUAL_UINT8(0, p.loc_source);
    TEST_ASSERT_EQUAL_UINT8(0, p.alt_source);
}

static void test_C7d_query_position_is_eight_bytes()
{
    uint8_t buf[MODEM_QUERY_POSITION_SIZE] = {};
    TEST_ASSERT_EQUAL_UINT16(8, modemEncodeQueryPosition(buf, sizeof(buf), 0x2EDCA04Cu));
    TEST_ASSERT_EQUAL_HEX8(0x4C, buf[0]);
    TEST_ASSERT_EQUAL_HEX8(0x2E, buf[3]);
    TEST_ASSERT_EQUAL_UINT16(0, modemEncodeQueryPosition(buf, 7, 0));
}

void setup()
{
    initializeTestEnvironment();
    UNITY_BEGIN();

    printf("\n=== Group C1: decode vectors from the Python implementation ===\n");
    RUN_TEST(test_C1a_position);
    RUN_TEST(test_C1b_position_negative_coordinates);
    RUN_TEST(test_C1c_region_profile);
    RUN_TEST(test_C1d_tx_params_negative_power);
    RUN_TEST(test_C1e_identity);
    RUN_TEST(test_C1f_channel);
    RUN_TEST(test_C1g_rx_policy);
    RUN_TEST(test_C1h_telemetry);
    RUN_TEST(test_C1i_send_binary);
    RUN_TEST(test_C1j_send_text_utf8);
    RUN_TEST(test_C1k_security);
    RUN_TEST(test_C1l_bootloader_magic);

    printf("\n=== Group C2: encoder sizes and field placement ===\n");
    RUN_TEST(test_C2a_encoded_sizes);
    RUN_TEST(test_C2b_send_reply_zeroes_tx_id_on_error);
    RUN_TEST(test_C2c_health_field_placement);
    RUN_TEST(test_C2d_rx_headers_and_negative_rssi);
    RUN_TEST(test_C2e_encoders_refuse_a_short_buffer);
    RUN_TEST(test_C2f_rx_data_refuses_to_exceed_max_payload);

    printf("\n=== Group C3: malformed input ===\n");
    RUN_TEST(test_C3a_fixed_layouts_reject_wrong_length);
    RUN_TEST(test_C3b_declared_length_beyond_the_buffer_is_rejected);
    RUN_TEST(test_C3c_channel_rejects_an_invalid_psk_length);
    RUN_TEST(test_C3d_security_rejects_an_invalid_key_length);
    RUN_TEST(test_C3e_decoders_never_read_past_the_buffer);

    RUN_TEST(test_C4a_identity_reply_matches_the_host_vector);
    RUN_TEST(test_C4b_node_info_matches_the_host_vector);
    RUN_TEST(test_C4c_name_encoders_refuse_a_buffer_that_cannot_hold_the_names);
    RUN_TEST(test_C4d_node_info_request_takes_exactly_four_bytes);

    RUN_TEST(test_C5a_telemetry_carries_a_trailing_string);
    RUN_TEST(test_C5b_telemetry_rejects_a_string_past_the_buffer);
    RUN_TEST(test_C5c_utf8_accepts_well_formed_sequences);
    RUN_TEST(test_C5d_utf8_rejects_the_classic_malformations);

    RUN_TEST(test_C6a_type_space_puts_every_response_in_its_own_quarter);
    RUN_TEST(test_C6b_the_four_kinds_never_overlap);
    RUN_TEST(test_C6c_every_defined_command_stays_inside_its_range);
    RUN_TEST(test_C6d_query_telemetry_is_eight_bytes);

    RUN_TEST(test_C7a_position_carries_a_tracker_fix);
    RUN_TEST(test_C7b_position_round_trips_through_the_encoder);
    RUN_TEST(test_C7c_unset_provenance_survives_untouched);
    RUN_TEST(test_C7d_query_position_is_eight_bytes);

    exit(UNITY_END());
}

void loop() {}
